## configs/pi_phase2/unisplit_pi4_phase2_bootrestore.defconfig
```kconfig
CONFIG_UK_NAME="unisplit-uk-pi4-phase2-bootrestore"
CONFIG_ARCH_ARM_64=y
CONFIG_MCPU_ARM64_CORTEX_A72=y
CONFIG_PLAT_KVM=y
CONFIG_KVM_VMM_RPI4=y
CONFIG_KVM_BOOT_PROTO_LXBOOT=y
CONFIG_LIBPL011=y
CONFIG_LIBPL011_EARLY_CONSOLE=y
CONFIG_LIBUKINTCTLR_GICV2=y
CONFIG_LIBUKDEBUG_PRINTK=y
CONFIG_LIBUKDEBUG_PRINTK_ERR=y
CONFIG_APPPI4PHASE2_BOOTRESTORE=y
```
